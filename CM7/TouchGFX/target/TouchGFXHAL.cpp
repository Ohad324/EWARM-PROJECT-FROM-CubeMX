/* USER CODE BEGIN Header */
/**
  ******************************************************************************
  * File Name          : TouchGFXHAL.cpp
  ******************************************************************************
  * This file is generated by TouchGFX Generator 4.19.1.
  ******************************************************************************
  * @attention
  *
  * Copyright (c) 2022 STMicroelectronics.
  * All rights reserved.
  *
  * This software is licensed under terms that can be found in the LICENSE file
  * in the root directory of this software component.
  * If no LICENSE file comes with this software, it is provided AS-IS.
  *
  ******************************************************************************
  */
/* USER CODE END Header */

#include <TouchGFXHAL.hpp>

/* USER CODE BEGIN TouchGFXHAL.cpp */

#include "stm32h7xx_hal.h"
#include <touchgfx/hal/OSWrappers.hpp>
#include "main.h"

/* USER CODE BEGIN Includes */
#include <touchgfx/hal/GPIO.hpp>
#include <touchgfx/hal/PartialFrameBufferManager.hpp>
#include "../Components/otm8009a/otm8009a.h"
#include <STM32H7Instrumentation.hpp>
#include "FreeRTOS.h"
#include "task.h"
#include "semphr.h"
#include "log_mutex.h"    /* LOG()/RLOG() — RTT logging */
#include "pfb_itm.h"     /* ITM_PFB(char) — bare-metal ITM port 0 trace */
/* USER CODE END Includes */

/* USER CODE BEGIN private defines */
/**
  * @brief  LCD Display OTM8009A ID
  */
#define LCD_OTM8009A_ID  ((uint32_t) 0)
/* USER CODE END private defines */

/* USER CODE BEGIN private variables */
volatile bool displayRefreshing = false;
volatile bool refreshRequested = true;
static int updateRegion = 0;
static uint16_t* currFbBase = 0;

/* USER CODE END private variables */

/* USER CODE BEGIN private functions */

/* USER CODE END private functions */

/* USER CODE BEGIN extern C prototypes */
extern "C" {
    extern DSI_HandleTypeDef hdsi;
    extern LTDC_HandleTypeDef hltdc;

    uint8_t pCols[4][4] =
    {
        {0x00, 0x00, 0x00, 0xC7}, /*   0 -> 199 */
        {0x00, 0xC8, 0x01, 0x8F}, /* 200 -> 399 */
        {0x01, 0x90, 0x02, 0x57}, /* 400 -> 599 */
        {0x02, 0x58, 0x03, 0x1F}, /* 600 -> 799 */
    };

    uint8_t pColLeft[] = { 0x00, 0x00, 0x01, 0x8f }; /*   0 -> 399 */
    uint8_t pColRight[] = { 0x01, 0x90, 0x03, 0x1F }; /* 400 -> 799 */

    /* Request tear interrupt at specific scanline. Implemented in BoardConfiguration.cpp */
    void LCD_ReqTear();

    /* Configures display to update indicated region of the screen (200pixel wide chunks) - 16bpp mode */
    void LCD_SetUpdateRegion(int idx);

    /* Configures display to update left half of the screen. Implemented in BoardConfiguration.cpp  - 24bpp mode*/
    void LCD_SetUpdateRegionLeft();

    /* Configures display to update right half of the screen. Implemented in BoardConfiguration.cpp - 24bpp mode*/
    void LCD_SetUpdateRegionRight();
}
/* USER CODE END extern C prototypes */

using namespace touchgfx;

/* USER CODE BEGIN private class objects */
static STM32H7Instrumentation mcuInstr;
/* USER CODE END private class objects */

TouchGFXHAL::TouchGFXHAL(touchgfx::DMA_Interface& dma, touchgfx::LCD& display, touchgfx::TouchController& tc, uint16_t width, uint16_t height)
/* USER CODE BEGIN TouchGFXHAL Constructor */
    : TouchGFXGeneratedHAL(dma,
                           display,
                           tc,
                           width,    /* was width+32 (832-cushion for Bug X);
                                      * removed in coordination with frameBuf
                                      * 800-wide allocation + CFBLR 800*3 pitch */
                           height)
      /* USER CODE END TouchGFXHAL Constructor */
{
    /* USER CODE BEGIN TouchGFXHAL Constructor Code */

    /* USER CODE END TouchGFXHAL Constructor Code */
}

void TouchGFXHAL::initialize()
{
    /* USER CODE BEGIN initialize step 1 */
    /* USER CODE END initialize step 1 */

    // Calling parent implementation of initialize().
    //
    // To overwrite the generated implementation, omit call to parent function
    // and implemented needed functionality here.
    // Please note, HAL::initialize() must be called to initialize the framework.

    TouchGFXGeneratedHAL::initialize();

    /* USER CODE BEGIN initialize step 2 */
    lockDMAToFrontPorch(false);

    /* Partial Framebuffer mode: framework renders the screen in 4 strips
     * of 120 rows each into the AXI-resident strip buffer. After each strip
     * is rendered, framework calls transmitBlock() (defined below) which
     * DSI-pushes that strip to OTM8009A panel GRAM. LTDC pulls only from
     * AXI SRAM -- FMC bus stays free for JPEG/CPU/MDMA. */
    setFrameRefreshStrategy(REFRESH_STRATEGY_PARTIAL_FRAMEBUFFER);
    /* setNumberOfBlocks(4) tells the framework there are 4 strips per frame
     * (480 rows / 120 lines per strip = 4). Earlier setNumberOfBlocks(1) was
     * wrong -- it made the framework treat each frame as "1 strip" and only
     * paint y=0. With 4, the framework iterates all 4 strips per frame.
     * Our 1-buffer allocator handles serialization via state machine + EOR. */
    setNumberOfBlocks(4);
    setMaxBlockLines(120);

    mcuInstr.init();
    setMCUInstrumentation(&mcuInstr);
    enableMCULoadCalculation(true);

    /* USER CODE END initialize step 2 */
}

#ifndef RELEASE_BUILD
volatile uint32_t g_pfb_dbg_taskentry_iter = 0;
volatile uint32_t g_pfb_dbg_backporch     = 0;
#endif

void TouchGFXHAL::taskEntry()
{
    /* USER CODE BEGIN taskEntry step 1 */

    /* USER CODE END taskEntry step 1 */

    enableLCDControllerInterrupt();
    enableInterrupts();

    /* USER CODE BEGIN taskEntry step 2 */

    /* USER CODE END taskEntry step 2 */

    OSWrappers::waitForVSync();
    backPorchExited();

    /* USER CODE BEGIN taskEntry step 3 */
    /* Enable the LCD, Send Display on DCS command to display */
    HAL_DSI_ShortWrite(&hdsi, LCD_OTM8009A_ID, DSI_DCS_SHORT_PKT_WRITE_P1, OTM8009A_CMD_DISPON, 0x00);
    /* USER CODE END taskEntry step 3 */

    ITM_PFB('1');   /* TouchGFXTask body entered */
    for (;;)
    {
        OSWrappers::waitForVSync();
        ITM_PFB('t');   /* loop top -- waitForVSync returned */
#ifndef RELEASE_BUILD
        g_pfb_dbg_taskentry_iter++;
        if ((g_pfb_dbg_taskentry_iter % 60u) == 1u) RLOG("[PFB-Lp] iter=", g_pfb_dbg_taskentry_iter);
#endif
        backPorchExited();
#ifndef RELEASE_BUILD
        g_pfb_dbg_backporch++;
#endif
    }
}

/**
 * Gets the frame buffer address used by the TFT controller.
 *
 * @return The address of the frame buffer currently being displayed on the TFT.
 */
uint16_t* TouchGFXHAL::getTFTFrameBuffer() const
{
    // Calling parent implementation of getTFTFrameBuffer().
    //
    // To overwrite the generated implementation, omit call to parent function
    // and implemented needed functionality here.

    /* USER CODE BEGIN getTFTFrameBuffer */
    return currFbBase;
    /* USER CODE END getTFTFrameBuffer */
}

/**
 * Sets the frame buffer address used by the TFT controller.
 *
 * @param [in] address New frame buffer address.
 */
void TouchGFXHAL::setTFTFrameBuffer(uint16_t* address)
{
    // Calling parent implementation of setTFTFrameBuffer(uint16_t* address).
    //
    // To overwrite the generated implementation, omit call to parent function
    // and implemented needed functionality here.

    /* USER CODE BEGIN setTFTFrameBuffer */
    TouchGFXGeneratedHAL::setTFTFrameBuffer(address);
    /* USER CODE END setTFTFrameBuffer */
}

/**
 * This function is called whenever the framework has performed a partial draw.
 *
 * @param rect The area of the screen that has been drawn, expressed in absolute coordinates.
 *
 * @see flushFrameBuffer().
 */
void TouchGFXHAL::flushFrameBuffer(const touchgfx::Rect& rect)
{
    // Calling parent implementation of flushFrameBuffer(const touchgfx::Rect& rect).
    //
    // To overwrite the generated implementation, omit call to parent function
    // and implemented needed functionality here.
    // Please note, HAL::flushFrameBuffer(const touchgfx::Rect& rect) must
    // be called to notify the touchgfx framework that flush has been performed.

    /* USER CODE BEGIN flushFrameBuffer step 1 */
    if (getFrameRefreshStrategy() == REFRESH_STRATEGY_PARTIAL_FRAMEBUFFER)
    {
        FrameBufferAllocator* alloc = getFrameBufferAllocator();
        if (alloc)
        {
            alloc->markBlockReadyForTransfer();
        }
        PartialFrameBufferManager::tryTransmitBlock();

        /* CRITICAL: with single-buffer StripAllocator, we must wait for the
         * just-triggered transmit to fully complete (DSI -> panel + EOR ISR
         * -> freeBlockAfterTransfer) before returning. Otherwise framework
         * immediately calls allocateBlock for next strip while state is still
         * SENDING -- our impl clobbers the state, the in-flight strip's
         * subsequent dispatch is lost, and only strip 0 ever transmits.
         * Bug found 2026-05-06 via SWO trace: aMgX bMM cMM dMM N E FF (no
         * X for strips 1/2/3). With this wait: aMgXEF bMgXEF cMgXEF dMgXEF N. */
        uint32_t timeout = 200000u;   /* ~few ms safety cap */
        while (touchgfx::transmitActive() && --timeout) { __NOP(); }
    }
    TouchGFXGeneratedHAL::flushFrameBuffer(rect);
    /* USER CODE END flushFrameBuffer step 1 */
}

/**
 * Configures the interrupts relevant for TouchGFX. This primarily entails setting
 * the interrupt priorities for the DMA and LCD interrupts.
 */
void TouchGFXHAL::configureInterrupts()
{
    // Calling parent implementation of configureInterrupts().
    //
    // To overwrite the generated implementation, omit call to parent function
    // and implemented needed functionality here.

    /* USER CODE BEGIN configureInterrupts */
    TouchGFXGeneratedHAL::configureInterrupts();
    /* USER CODE END configureInterrupts */
}

/**
 * Used for enabling interrupts set in configureInterrupts()
 */
void TouchGFXHAL::enableInterrupts()
{
    // Calling parent implementation of enableInterrupts().
    //
    // To overwrite the generated implementation, omit call to parent function
    // and implemented needed functionality here.

    /* USER CODE BEGIN enableInterrupts */
    TouchGFXGeneratedHAL::enableInterrupts();
    /* USER CODE END enableInterrupts */
}

/**
 * Used for disabling interrupts set in configureInterrupts()
 */
void TouchGFXHAL::disableInterrupts()
{
    // Calling parent implementation of disableInterrupts().
    //
    // To overwrite the generated implementation, omit call to parent function
    // and implemented needed functionality here.

    /* USER CODE BEGIN disableInterrupts */
    TouchGFXGeneratedHAL::disableInterrupts();
    /* USER CODE END disableInterrupts */
}

/**
 * Configure the LCD controller to fire interrupts at VSYNC. Called automatically
 * once TouchGFX initialization has completed.
 */
void TouchGFXHAL::enableLCDControllerInterrupt()
{
    // Calling parent implementation of enableLCDControllerInterrupt().
    //
    // To overwrite the generated implementation, omit call to parent function
    // and implemented needed functionality here.


    /* USER CODE BEGIN enableLCDControllerInterrupt */
    LCD_ReqTear();
    __HAL_DSI_CLEAR_FLAG(&hdsi, DSI_IT_ER);
    __HAL_DSI_CLEAR_FLAG(&hdsi, DSI_IT_TE);
    __HAL_DSI_ENABLE_IT(&hdsi, DSI_IT_TE);
    __HAL_DSI_ENABLE_IT(&hdsi, DSI_IT_ER);
    LTDC->IER = 3; /* Enable line and FIFO underrun interrupts */
    /* USER CODE END enableLCDControllerInterrupt */
}

/* USER CODE BEGIN virtual overloaded methods */
void TouchGFXHAL::setFrameBufferStartAddresses(void* frameBuffer, void* doubleBuffer, void* animationStorage)
{
    currFbBase = (uint16_t*)frameBuffer;
    HAL::setFrameBufferStartAddresses(frameBuffer, doubleBuffer, animationStorage);
}

#ifndef RELEASE_BUILD
volatile uint32_t g_pfb_dbg_beginframe = 0;
volatile uint32_t g_pfb_dbg_beginframe_ret_true  = 0;
volatile uint32_t g_pfb_dbg_beginframe_ret_false = 0;
/* g_pfb_dbg_taskentry_iter / g_pfb_dbg_backporch defined earlier near taskEntry */
#endif

bool TouchGFXHAL::beginFrame()
{
    ITM_PFB('B');   /* beginFrame entry (use endFrame N to bracket) */
    refreshRequested = false;
    bool r = HAL::beginFrame();
#ifndef RELEASE_BUILD
    g_pfb_dbg_beginframe++;
    if (r) g_pfb_dbg_beginframe_ret_true++;
    else   g_pfb_dbg_beginframe_ret_false++;
#endif
    return r;
}

void TouchGFXHAL::endFrame()
{
    ITM_PFB('N');
    TouchGFXGeneratedHAL::endFrame();
#ifndef RELEASE_BUILD
    /* Bug Y diagnostic — count endFrame() calls + how many had
     * frameBufferUpdatedThisFrame == true. If `updated` stops growing after
     * press 1, the HAL precompiled flushFrameBuffer never set the flag for
     * subsequent renders → H1. Logged once per ~60 frames (~1 s @ 60 Hz). */
    static uint32_t ef_total   = 0;
    static uint32_t ef_updated = 0;
    ++ef_total;
    if (frameBufferUpdatedThisFrame) { ++ef_updated; }
    if ((ef_total % 60u) == 0u)
    {
        LOG("[LCD-EF] frames=%lu updated=%lu fbUp=%u\n",
            (unsigned long)ef_total, (unsigned long)ef_updated,
            (unsigned)frameBufferUpdatedThisFrame);
        /* Bug Y / FMC-conflict probe per Gemini hint — dump the latched HW
         * status registers. Sticky flags survive until cleared via ICR, so
         * one dump per second catches any underrun / DMA transfer error /
         * bus fault that fired any time before now.
         *
         * What to look for:
         *   LTDC.ISR bit 1 (FUIF) → LTDC FIFO underrun (SDRAM starvation)
         *   LTDC.ISR bit 2 (TERRIF) → LTDC transfer error
         *   DMA1/2 LISR/HISR — TEIF bits → DMA transfer errors
         *   SCB.CFSR bit 8/9 (IBUSERR/PRECISERR) + BFAR → CPU bus fault. */
        LOG("[LCD-HW] LTDC.ISR=0x%08lX D1L=0x%08lX D1H=0x%08lX D2L=0x%08lX D2H=0x%08lX "
            "CFSR=0x%08lX BFAR=0x%08lX\n",
            (unsigned long)LTDC->ISR,
            (unsigned long)DMA1->LISR, (unsigned long)DMA1->HISR,
            (unsigned long)DMA2->LISR, (unsigned long)DMA2->HISR,
            (unsigned long)SCB->CFSR, (unsigned long)SCB->BFAR);
    }
#endif
    if (frameBufferUpdatedThisFrame)
    {
        refreshRequested = true;
    }
}
/* USER CODE END virtual overloaded methods */

/* ─────────────────────────────────────────────────────────────────────────
 * Partial Framebuffer (PFB) callbacks — touchgfx::-namespace free functions
 * called by PartialFrameBufferManager when the framework renders one strip
 * (800x120 RGB888) and needs us to push it to OTM8009A panel GRAM via DSI.
 * ───────────────────────────────────────────────────────────────────────── */
namespace touchgfx {

/* DSI/LTDC busy flag, cleared by HAL_DSI_EndOfRefreshCallback when the
 * panel GRAM update for the current strip is complete. */
static volatile bool s_dsi_busy = false;

#ifndef RELEASE_BUILD
/* PFB strip dispatch instrumentation. Read via cspybat:
 *   __readMemory32(&g_pfb_dbg_count, "Memory")
 *   __readMemory32(&g_pfb_dbg_mask,  "Memory")
 * mask bits: 0=y0, 1=y120, 2=y240, 3=y360.  Expected after 60+ frames:
 * count >> 60 and mask == 0xF if all 4 strips dispatch. */
volatile uint32_t g_pfb_dbg_count   = 0;
volatile uint32_t g_pfb_dbg_mask    = 0;
volatile uint32_t g_pfb_dbg_last_y  = 0xFFFFFFFFu;
volatile uint32_t g_pfb_dbg_last_h  = 0;
volatile uint32_t g_pfb_dbg_last_px = 0;
#endif

void transmitBlock(const uint8_t* pixels, uint16_t x, uint16_t y,
                   uint16_t w, uint16_t h)
{
    (void)x; (void)w;   /* Always full panel width 0..799 */
    /* Emit ITM events BEFORE any DSI work so we can tell if a hang is in
     * the markers vs. in DSI. y/10 → 0/12/24/36 with hardware cycle stamp. */
    ITM_PFB('X');                           /* transmitBlock entry */
    /* ITM_EVENT8(0, (uint8_t)(y / 10u));  -- temporarily disabled: suspect of
     * hanging the trace. Re-enable after confirming non-blocking. */

#ifndef RELEASE_BUILD
    g_pfb_dbg_count++;
    g_pfb_dbg_last_y  = y;
    g_pfb_dbg_last_h  = h;
    g_pfb_dbg_last_px = (uint32_t)pixels;
    if      (y ==   0) g_pfb_dbg_mask |= 1u;
    else if (y == 120) g_pfb_dbg_mask |= 2u;
    else if (y == 240) g_pfb_dbg_mask |= 4u;
    else if (y == 360) g_pfb_dbg_mask |= 8u;
    /* DIAGNOSTIC: log every transmitBlock call to confirm dispatch is firing.
     * If [PFB-TX] never appears, transmitBlock is NEVER called -- the EOR
     * handler / framework state machine is the bug. */
    RLOG("[PFB-TX] y=", y);
#endif

    /* 1. Set OTM8009A target window: full 800-pixel-wide row range, rows y..y+h-1. */
    uint8_t pCol[4] = { 0x00, 0x00, 0x03, 0x1F };   /* cols 0..799 */
    uint8_t pPag[4];
    pPag[0] = (uint8_t)((y          ) >> 8);
    pPag[1] = (uint8_t)((y          ) & 0xFFu);
    pPag[2] = (uint8_t)((y + h - 1u) >> 8);
    pPag[3] = (uint8_t)((y + h - 1u) & 0xFFu);

    HAL_DSI_LongWrite(&hdsi, 0, DSI_DCS_LONG_PKT_WRITE, 4, OTM8009A_CMD_CASET, pCol);
    HAL_DSI_LongWrite(&hdsi, 0, DSI_DCS_LONG_PKT_WRITE, 4, OTM8009A_CMD_PASET, pPag);

    /* 2. Drain DSI host's command + payload FIFOs so CASET/PASET are fully
     *    transmitted before we re-arm LTDCEN via HAL_DSI_Refresh. Same poll
     *    pattern the LEFT/RIGHT split previously used between halves. */
    {
        const uint32_t empty_mask = DSI_GPSR_CMDFE | DSI_GPSR_PWRFE;
        uint32_t to = 100000u;
        while ((hdsi.Instance->GPSR & empty_mask) != empty_mask && --to) { __NOP(); }
    }

    /* 3. Point LTDC at the strip pixels (always frameBuf base in single-block
     *    PFB mode) and trigger DSI scan. EOR ISR clears s_dsi_busy. */
    LTDC_LAYER(&hltdc, 0)->CFBAR = (uint32_t)pixels;
    __HAL_LTDC_RELOAD_IMMEDIATE_CONFIG(&hltdc);

    s_dsi_busy = true;
    HAL_DSI_Refresh(&hdsi);
}

int transmitActive()
{
    return s_dsi_busy ? 1 : 0;
}

int shouldTransferBlock(uint16_t /*bottom*/)
{
    return s_dsi_busy ? 0 : 1;
}

void waitUntilTransmitEnd()
{
    while (s_dsi_busy) { __WFE(); }
}

void waitUntilCanTransferBlock(uint16_t /*bottom*/)
{
    while (s_dsi_busy) { __WFE(); }
}

/* PFB framework hooks (declared in FrameBufferAllocator.hpp, NOT defined
 * by the framework -- each HAL must supply them). Called by the framework
 * to wait for / signal transfer events. On this hardware:
 *   - SignalBlockDrawn(): a strip just hit DRAWN state; nothing to do
 *     because tryTransmitBlock() (called from flushFrameBuffer) starts
 *     the transmission directly. Kept as a no-op for symmetry.
 *   - WaitOnTransfer(): block until in-flight DSI strip completes.
 *     Same WFE loop the other wait functions use; EOR ISR clears the flag. */
void FrameBufferAllocatorSignalBlockDrawn()
{
    /* No-op: tryTransmitBlock() in flushFrameBuffer() initiates the transfer. */
}

void FrameBufferAllocatorWaitOnTransfer()
{
    while (s_dsi_busy) { __WFE(); }
}

}   /* namespace touchgfx */

/* USER CODE BEGIN extern C functions */
extern "C" {

    /**************************** LINK OTM8009A (Display driver) ******************/
    /**
      * @brief  DCS or Generic short/long write command
      * @param  ChannelNbr Virtual channel ID
      * @param  Reg Register to be written
      * @param  pData pointer to a buffer of data to be write
      * @param  Size To precise command to be used (short or long)
      * @retval BSP status
      */
    int32_t DSI_IO_Write(uint16_t ChannelNbr, uint16_t Reg, uint8_t* pData, uint16_t Size)
    {
        int32_t ret = BSP_ERROR_NONE;

        if (Size <= 1U)
        {
            if (HAL_DSI_ShortWrite(&hdsi, ChannelNbr, DSI_DCS_SHORT_PKT_WRITE_P1, Reg, (uint32_t)pData[Size]) != HAL_OK)
            {
                ret = BSP_ERROR_BUS_FAILURE;
            }
        }
        else
        {
            if (HAL_DSI_LongWrite(&hdsi, ChannelNbr, DSI_DCS_LONG_PKT_WRITE, Size, (uint32_t)Reg, pData) != HAL_OK)
            {
                ret = BSP_ERROR_BUS_FAILURE;
            }
        }

        return ret;
    }

    /**
      * @brief  DCS or Generic read command
      * @param  ChannelNbr Virtual channel ID
      * @param  Reg Register to be read
      * @param  pData pointer to a buffer to store the payload of a read back operation.
      * @param  Size  Data size to be read (in byte).
      * @retval BSP status
      */
    int32_t DSI_IO_Read(uint16_t ChannelNbr, uint16_t Reg, uint8_t* pData, uint16_t Size)
    {
        int32_t ret = BSP_ERROR_NONE;

        if (HAL_DSI_Read(&hdsi, ChannelNbr, pData, Size, DSI_DCS_SHORT_PKT_READ, Reg, pData) != HAL_OK)
        {
            ret = BSP_ERROR_BUS_FAILURE;
        }

        return ret;
    }

    /**
     * Request TE at scanline.
     */
    void LCD_ReqTear(void)
    {
        uint8_t ScanLineParams[2];
        uint16_t scanline = 500;

        ScanLineParams[0] = scanline >> 8;
        ScanLineParams[1] = scanline & 0x00FF;

        HAL_DSI_LongWrite(&hdsi, 0, DSI_DCS_LONG_PKT_WRITE, 2, 0x44, ScanLineParams);
        HAL_DSI_ShortWrite(&hdsi, 0, DSI_DCS_SHORT_PKT_WRITE_P1, OTM8009A_CMD_TEEON, 0x00);
    }

    /**
     * Request DSI enable if it wasn't already done.
     */
    void LCD_ReqEnable(void)
    {
        static bool firstRefreshRequested = false;

        // Enable DSI interface once the very first framebuffer is ready for display
        if (!firstRefreshRequested)
        {
            firstRefreshRequested = true;

            /* Send Display on DCS Command to display */
            HAL_DSI_ShortWrite(&(hdsi),
                               0,
                               DSI_DCS_SHORT_PKT_WRITE_P1,
                               OTM8009A_CMD_DISPON,
                               0x00);
        }
    }

    void LCD_SetUpdateRegion(int idx)
    {
        HAL_DSI_LongWrite(&hdsi, 0, DSI_DCS_LONG_PKT_WRITE, 4, OTM8009A_CMD_CASET, pCols[idx]);
    }

    void LCD_SetUpdateRegionLeft()
    {
        HAL_DSI_LongWrite(&hdsi, 0, DSI_DCS_LONG_PKT_WRITE, 4, OTM8009A_CMD_CASET, pColLeft);
    }

    void LCD_SetUpdateRegionRight()
    {
        HAL_DSI_LongWrite(&hdsi, 0, DSI_DCS_LONG_PKT_WRITE, 4, OTM8009A_CMD_CASET, pColRight);
    }

    void LCD_SetBrightness(int value)
    {
        HAL_DSI_ShortWrite(&hdsi,
                           0, DSI_DCS_SHORT_PKT_WRITE_P1,
                           OTM8009A_CMD_WRDISBV, (uint16_t)(value * 255) / 100);
    }

    /* TE callback (panel "GRAM-safe to update" pulse).
     * For PFB, we only signal VSync to the framework — the strip transmission
     * is driven by the framework calling transmitBlock() (defined above), not
     * by the LEFT/RIGHT trigger that lived here. */
    void HAL_DSI_TearingEffectCallback(DSI_HandleTypeDef* hdsi)
    {
        (void)hdsi;
        ITM_PFB('T');
        GPIO::set(GPIO::VSYNC_FREQ);
        HAL::getInstance()->vSync();
        OSWrappers::signalVSync();
        GPIO::clear(GPIO::VSYNC_FREQ);
    }

    /* EOR (End-of-Refresh) callback — fires when LTDC has finished sending
     * one strip's pixels via DSI to OTM8009A GRAM. For PFB we just clear the
     * per-strip busy flag, ensure the panel display is enabled, and let the
     * PartialFrameBufferManager schedule the next block transmission if any. */
    void HAL_DSI_EndOfRefreshCallback(DSI_HandleTypeDef* hdsi)
    {
        (void)hdsi;
        ITM_PFB('E');

        /* EOR semantics: the previously-transmitting strip is now COMPLETE.
         * Sequence:
         *   1. Free the just-finished SENDING block (state -> EMPTY).
         *   2. Clear s_dsi_busy so transmitActive()==false -- framework's
         *      tryTransmitBlockFromIRQ knows it can start a new transfer.
         *   3. Call tryTransmitBlockFromIRQ. If a DRAWN block exists (queued
         *      strip 1/2/3), it dispatches: getBlockForTransfer -> transmitBlock
         *      -> transmitBlock sets s_dsi_busy=true again. The for(;;) chain
         *      continues until no more DRAWN blocks remain.
         *   4. waitOnTransfer (in the GUI task) wakes when s_dsi_busy=false. */

        if (HAL::getInstance())
        {
            touchgfx::FrameBufferAllocator* alloc = HAL::getInstance()->getFrameBufferAllocator();
            if (alloc)
            {
                alloc->freeBlockAfterTransfer();
            }
        }

        /* Clear FIRST so transmitActive() reports false. tryTransmitBlockFromIRQ
         * will then either:
         *  - dispatch the next DRAWN strip (transmitBlock re-sets s_dsi_busy=true)
         *  - find nothing to do (s_dsi_busy stays false, waitOnTransfer wakes) */
        touchgfx::s_dsi_busy = false;

        touchgfx::PartialFrameBufferManager::tryTransmitBlockFromIRQ();

        /* Turn on the display the first time a strip lands in panel GRAM. */
        LCD_ReqEnable();

        /* Signal frontPorchEntered if the framework is tracking it. */
        if (HAL::getInstance())
        {
            HAL::getInstance()->frontPorchEntered();
        }
    }

    portBASE_TYPE IdleTaskHook(void* p)
    {
        if ((int)p) //idle task sched out
        {
            touchgfx::HAL::getInstance()->setMCUActive(true);
        }
        else //idle task sched in
        {
            touchgfx::HAL::getInstance()->setMCUActive(false);
        }
        return pdTRUE;
    }

}
/* USER CODE END extern C functions */

/* USER CODE END TouchGFXHAL.cpp */

/************************ (C) COPYRIGHT STMicroelectronics *****END OF FILE****/
